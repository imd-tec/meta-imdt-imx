## conf/distro/imdt-imx-xwayland.conf
```bitbake
# IMDT i.MX DISTRO for Wayland with X11

require conf/distro/poky.conf

DISTRO_NAME = "IMDT Pico BSP"
DISTRO = "imdt-imx-xwayland"
BB_ENV_PASSTHROUGH_ADDITIONS:append = " IMDT_DISTRO_VERSION"
IMDT_DISTRO_VERSION ?= "0.0.0"
DISTRO_VERSION = "${IMDT_DISTRO_VERSION}"

REMOVE_VULKAN_FEATURE_mx8 = ""
POKY_DEFAULT_DISTRO_FEATURES:remove      = "wayland"
POKY_DEFAULT_DISTRO_FEATURES:append_mx8  = " jailhouse"

DISTRO_FEATURES:append_mx8 = " virtualization"

INHERIT:remove = "uninative"

PACKAGECONFIG:append:pn-gstreamer1.0-plugins-ugly = " x264"

# Remove conflicting backends
DISTRO_FEATURES:remove = "directfb "
DISTRO_FEATURES:append = " x11 wayland pam usrmerge "
# Use Systemd
INIT_MANAGER = "systemd"
```

## conf/distro/include/imdt-imx-base.inc
```bitbake
require conf/distro/poky.conf

DISTRO_NAME = "IMDT Pico BSP"

REMOVE_VULKAN_FEATURE_mx8 = ""
POKY_DEFAULT_DISTRO_FEATURES:remove      = "wayland"
POKY_DEFAULT_DISTRO_FEATURES:append_mx8  = " jailhouse"

DISTRO_FEATURES:append_mx8 = " virtualization"

INHERIT:remove = "uninative"

PACKAGECONFIG:append:pn-gstreamer1.0-plugins-ugly = " x264"
```
